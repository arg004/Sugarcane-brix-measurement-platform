## firmware/eis_fw/components/ems/Kconfig
```kconfig
menu "EmStat Pico (UART)"

config APP_EMS_UART_NUM
    int "UART port (0/1/2)"
    range 0 2
    default 1

config APP_EMS_TX
    int "EMS TX (ESP → EmStat RX)"
    default 17

config APP_EMS_RX
    int "EMS RX (EmStat → ESP)"
    default 18

config APP_EMS_BAUD
    int "Baudrate"
    default 230400

config EMS_PROBE_TIMEOUT_MS
    int "EMS probe timeout (ms)"
    range 50 5000
    default 1000

endmenu
```

## firmware/eis_fw/components/measure/Kconfig
```kconfig
menu "Measurement"

config APP_MEAS_TOPIC_PREFIX
    string "MQTT topic prefix"
    default "devices"

config APP_MEAS_DATA_DIR
    string "Data directory on SD"
    default "/sd/data"

config APP_MEAS_MAX_POINTS
    int "Max synthetic points per job"
    range 1 65535
    default 1024

endmenu
```

## firmware/eis_fw/components/mux/Kconfig
```kconfig
menu "Multiplexer (TMUX1109)"

config APP_MUX_TMUX1109
    bool "Enable TMUX1109 front-end multiplexers"
    default y

if APP_MUX_TMUX1109

config APP_MUX1_A0_PIN
    int "TMUX1 (CE/RE) A0 GPIO"
    default 6

config APP_MUX1_A1_PIN
    int "TMUX1 (CE/RE) A1 GPIO"
    default 7

config APP_MUX2_A0_PIN
    int "TMUX2 (WE) A0 GPIO"
    default 4

config APP_MUX2_A1_PIN
    int "TMUX2 (WE) A1 GPIO"
    default 5

config APP_MUX_SAFE_SEL
    int "Safe/default select code (0..3)"
    range 0 3
    default 3
    help
      Two-bit select code applied to both TMUXes at boot. 3 (=11b) is often
      a spare channel you can leave unconnected to make a ‘no‑sensor’ state.

endif # APP_MUX_TMUX1109

endmenu
```

## firmware/eis_fw/components/network/Kconfig
```kconfig
menu "App"
    config APP_WIFI_SSID
        string "Wi‑Fi SSID"
        default "AGalib"
    config APP_WIFI_PASS
        string "Wi‑Fi Password"
        default "12345678"
    config APP_TIMEZONE
        string "POSIX TZ string"
        default "CST6CDT,M3.2.0/2,M11.1.0/2"
        help
            Example: US Central with DST rules.
endmenu
```

## firmware/eis_fw/components/regen/Kconfig
```kconfig
menu "App → Regeneration"
    config APP_REGEN_GPIO_1
        int "Regen GPIO for sensor 1 (-1 to disable)"
        range -1 48
        default 23
    config APP_REGEN_GPIO_2
        int "Regen GPIO for sensor 2 (-1 to disable)"
        range -1 48
        default 24
    config APP_REGEN_GPIO_3
        int "Regen GPIO for sensor 3 (-1 to disable)"
        range -1 48
        default 25

    config APP_REGEN_ACTIVE_HIGH
        bool "Regen output is active‑high (default: OFF)"
        default n   # active‑LOW by default

    config APP_REGEN_DEFAULT_MS
        int "Pulse width (ms)"
        range 50 600000
        default 1000

    config APP_REGEN_COOLDOWN_MS
        int "Cooldown between jobs (ms)"
        range 0 60000
        default 5000

    config APP_REGEN_WASH_ENABLE
        bool "Enable DI water wash (all 3 pins simultaneously)"
        default y

    config APP_REGEN_WASH_MS
        int "DI wash pulse width (ms)"
        range 50 600000
        default 1000

    config APP_REGEN_TOPIC_PREFIX
        string "MQTT topic prefix"
        default "devices"

    config APP_REGEN_MQTT_URI
        string "MQTT broker URI (leave empty to reuse heartbeat URI, if set)"
        default ""
endmenu
```

## firmware/eis_fw/components/storage/Kconfig
```kconfig
menu "App → Storage (microSD)"

    comment "Fixed wiring (your board)"
    config APP_SDMMC_CLK
        int "SD CLK"
        default 38
    config APP_SDMMC_CMD
        int "SD CMD (also SPI MOSI)"
        default 37
    config APP_SDMMC_D0
        int "SD DAT0 (also SPI MISO)"
        default 39
    config APP_SDMMC_D1
        int "SD DAT1"
        default 40
    config APP_SDMMC_D2
        int "SD DAT2"
        default 35
    config APP_SDMMC_D3
        int "SD DAT3 (also SPI CS)"
        default 36

    config APP_SDMMC_WIDTH_4BIT
        bool "Use 4-bit SDMMC bus"
        default y

    config APP_SD_FORCE_SPI
        bool "Force SPI mode (skip SDMMC)"
        default n

    config APP_SD_INTERNAL_PULLUPS
        bool "Enable internal pull-ups on CMD/D0..D3 (dev aid)"
        default y
        help
          Keep ON for dev boards without external 10k pull-ups.
          CLK is never pulled up.

    config APP_SD_SPI_HOST
        int "SPI host (2=SPI2, 3=SPI3)"
        range 2 3
        default 2

    config APP_SD_MAX_FILES
        int "Max open files"
        range 2 16
        default 5


    config APP_SD_MOUNT_POINT
        string "Mount point"
        default "/sd"
        help
            Path used when mounting the card.

    config APP_SD_CD_GPIO
        int "Card-detect GPIO"
        default 41

    config APP_SD_CD_ACTIVE_LOW
        bool "CD is active low (0 = inserted)"
        default y

    config APP_SD_CD_DEBOUNCE_MS
        int "Card-detect debounce (ms)"
        range 10 1000
        default 80

    config APP_SD_AUTO_MOUNT
        bool "Auto mount on insert / unmount on remove"
        default y

endmenu
```

## firmware/eis_fw/components/telemetry/Kconfig
```kconfig
# firmware/components/telemetry/Kconfig  (new)
menu "App → Telemetry"
    config APP_HB_MQTT_URI
        string "Heartbeat MQTT URI"
        default "mqtt://test.mosquitto.org:1883"
    config APP_HB_TOPIC_PREFIX
        string "Heartbeat topic prefix"
        default "devices"
    config APP_HB_PERIOD_SEC
        int "Heartbeat period (sec)"
        range 5 86400
        default 30
    config APP_HB_QOS
        int "Heartbeat QoS (0 or 1)"
        range 0 1
        default 0
    config APP_HB_KEEPALIVE
        int "MQTT keepalive (seconds)"
        range 10 600
        default 60
endmenu
```
